#include "stm32f10x.h"
#include "lcd.h"
#include"System_Configuration.h"
#include "5X8ziku.h"

const uint8_t graphicPS[] = 
{
0x1F,0x1F,0x1F,0x1F,0x1F,0x1F,0x1F,0x1F,0x1F,0x1F,0x1F,0x1F,0x1F,0x1F,0x1F,0x1F,
0x1F,0x1F,0x1F,0x1F,0x1F,0x1F,0x1F,0x1F,0x1F,0x1F,0x1F,0x1F,0x1F,0x0F,0x0F,0x0F,
0x0F,0x07,0x07,0x01,0x00,0x00,0x00,0x07,0x0F,0x0F,0x0F,0x0F,0x0F,0x0F,0x0F,0x0F,
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0x00,0x00,0x00,0x00,0x00,0x00,0x00,0x00,0x00,0x00,0x00,0x00,0x00,0x00,0x00,0x00,
};
const uint8_t graphic1[]=
{
/*--  宽度x高度=128x64  --*/
0xFF,0x01,0x01,0x01,0x01,0x01,0x01,0x01,0x01,0x01,0x01,0x01,0x01,0x01,0x01,0x01,
0x01,0x01,0x01,0x01,0x01,0x01,0x01,0x01,0x01,0x01,0x01,0x01,0x01,0x01,0x01,0x01,
0x01,0x01,0x01,0x01,0x01,0x81,0xC1,0x41,0x41,0x41,0x01,0x01,0x01,0x01,0x01,0x01,
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0x80,0x80,0x80,0x80,0x80,0x80,0x80,0x80,0x80,0x80,0x80,0x80,0x80,0x80,0x80,0xFF,
};

void LCM_IO_Init(void)
{
	GPIO_InitTypeDef GPIO_InitStructure;
	RCC_APB2PeriphClockCmd(	RCC_APB2Periph_GPIOB | 	RCC_APB2Periph_GPIOE | RCC_APB2Periph_GPIOG  , ENABLE );	//使能GPIOB 、GPIOE时钟
	   
	GPIO_InitStructure.GPIO_Pin = GPIO_Pin_5 | GPIO_Pin_6|GPIO_Pin_7| GPIO_Pin_9;
	GPIO_InitStructure.GPIO_Mode = GPIO_Mode_Out_PP ;   //推挽输出
	GPIO_InitStructure.GPIO_Speed = GPIO_Speed_50MHz;
	GPIO_Init(GPIOB, &GPIO_InitStructure);
	
	GPIO_InitStructure.GPIO_Pin = GPIO_Pin_8;
	GPIO_InitStructure.GPIO_Mode = GPIO_Mode_Out_PP ;   //推挽输出
	GPIO_InitStructure.GPIO_Speed = GPIO_Speed_50MHz;
	GPIO_Init(GPIOG, &GPIO_InitStructure);
}
//reset
void HDReset()
{
//	LCM_RESET = 0;
	GPIO_ResetBits(GPIOB,GPIO_Pin_9);
	
	delay_ms(2);
	GPIO_SetBits(GPIOB,GPIO_Pin_9);
//	LCM_RESET = 1;
	delay_ms(4);
}

void Write_ST7567_DISPLAY_DATA_serial(uint8_t  DADA)
{   
	uint8_t bit8;
	LCM_RS(Bit_SET);
	LCM_CSB(Bit_RESET);				

	for(bit8 = 0; bit8 < 8; bit8++)
	{
		LCM_SCL(Bit_RESET);
		if((DADA & 0x80) == 0x80)
			LCM_SDA(Bit_SET);
		else
			LCM_SDA(Bit_RESET);
		LCM_SCL(Bit_SET);
		DADA = (DADA <<1 );
	}
}

void Write_ST7567_COM(uint8_t COMDADA)
{
	uint8_t bit8;
        LCM_RS(Bit_RESET);
	LCM_CSB(Bit_RESET);			
	for(bit8=0;bit8<8;bit8++)
	{
		LCM_SCL(Bit_RESET);
		if((COMDADA & 0x80) == 0x80)
			LCM_SDA(Bit_SET);
		else		
			LCM_SDA(Bit_RESET);
		LCM_SCL(Bit_SET);
		COMDADA = (COMDADA <<1 );

	}	
}


void Init_ST7567(void)
{
		HDReset();
		delay_ms(100);

		Write_ST7567_COM(0xe2);	 //Soft rest

		Write_ST7567_COM(0xa2);	 //SET LCD bias(A2-1/9bias; A3-1/7bias)
		Write_ST7567_COM(0xa0);	 //SET ADC NORMAL(OB-POR seg0-00h) A0: NORMAL  A1: REVERSE
		Write_ST7567_COM(0xc8);	   //SET COM OUTPUT SCAN DIRECTION(0XXXB-NORMAL)-POR  COM63-->COM0

		Write_ST7567_COM(0xa4);	   // SET DISPLAY NORMAL (0B-NORMAL)-POR  A4:NORMAL A5:ENTIRE DISPLAY ON
		Write_ST7567_COM(0xa6);	   //SET NORMAL DISPLAY MODE(0B-NORMAL)  A6:NORMAL  A7:REVERSE
		Write_ST7567_COM(0x25);	   //SET INTERNAL REGULATOR RESDASTOR RATIO(100B)-POR

		Write_ST7567_COM(0x81);

		Write_ST7567_COM(0x1a);	   // SET CONTRAST CONTROL REGISTER(00,0000H-11,1111H) 30  对比度请修改此值，调浓增大此值，反之调淡。
		Write_ST7567_COM(0x2f);	   //SET POWER CONTROL REGISTER (ALL INTERNAL)

		Write_ST7567_COM(0x40);	   //end of initialzation
		Write_ST7567_COM(0xaf);	   //DisPlay On
}


void clear_screen(uint8_t data)
{
	uint8_t i,j;
	for(i=0;i<9;i++)
	{
		LCM_RS(Bit_SET);
		Write_ST7567_COM(0xb0+i);
		Write_ST7567_COM(0x10);
		Write_ST7567_COM(0x00);
		for(j=0;j<132;j++)
			Write_ST7567_DISPLAY_DATA_serial(data);
	}
}

void Display_pic1(void)
{
	uint8_t i,j;
	uint8_t adressd=0;
	for(i=0;i<8;i++)
	{
		LCM_CSB(Bit_RESET);
		Write_ST7567_COM(0xb0+i);
	  Write_ST7567_COM(0x10);
		Write_ST7567_COM(0x00);
		for(j=0;j<128;j++)
		{
			Write_ST7567_DISPLAY_DATA_serial(graphic1[adressd]);
			adressd++;
		}
	}
} 

void Lcd_Address(uint16_t page,uint16_t column)
{
	column=column-0x01;
	Write_ST7567_COM(0xb0+page-1);   /*设置页地址*/ //1-8
	Write_ST7567_COM(0x10+(column>>4&0x0f));	/*设置列地址的高4位*///0-128
	Write_ST7567_COM(column&0x0f);	/*设置列地址的低4位*/	
}


/*显示128x64点阵图像*/
void Display_128x64(u8 *dp)
{
	uint8_t i,j;
	for(j=0;j<8;j++)
	{
		Lcd_Address(j+1,1);
		for (i=0;i<128;i++)
		{	
		  Write_ST7567_DISPLAY_DATA_serial(*dp);	 	/*写数据到LCD,每写完一个8位的数据后列地址自动加1*/
		  dp++;
		}
	}
}

/*显示16x16点阵图像、汉字、生僻字或16x16点阵的其他图标*/
void Display_Graphic_16x16(uint8_t page,uint8_t column,uint8_t *dp)
{
	uint8_t i,j;
	for(j=0;j<2;j++)
	{
		Lcd_Address(page+j,column);
		for (i=0;i<16;i++)
		{	
			Write_ST7567_DISPLAY_DATA_serial(*dp);	 /*写数据到LCD,每写完一个8位的数据后列地址自动加1*/
			dp++;
		}
	}
}

/*显示8x16点阵图像、ASCII, 或8x16点阵的自造字符、其他图标*/
void Display_Graphic_8x16(uint8_t page,uint8_t column,uint8_t *dp)
{
	uint8_t i,j;
	for(j=0;j<2;j++)
	{
		Lcd_Address(page+j,column);
		for (i=0;i<8;i++)
		{	
			Write_ST7567_DISPLAY_DATA_serial(*dp);	 	/*写数据到LCD,每写完一个8位的数据后列地址自动加1*/
			dp++;
		}
	}
}

/*显示5*8点阵图像、ASCII, 或5x8点阵的自造字符、其他图标*/
void Display_Graphic_5x8(uint8_t page,uint8_t column,uint8_t *dp)
{
	uint8_t col_cnt;
    Lcd_Address(page,column);
	for (col_cnt=0;col_cnt<5;col_cnt++)
	{	
		Write_ST7567_DISPLAY_DATA_serial(*dp);
		dp++;
	}
}

void Scribing(void)
{
	uint8_t i;
	Lcd_Address(2, 1);
	for (i=0; i<128; i++)
	{
		Write_ST7567_DISPLAY_DATA_serial(0x08);
	}		
}

void DisplayFont(uint8_t page, uint8_t column, uint8_t No, uint8_t typeface)
{
	uint8_t *dp;
	switch (typeface)
	{
		case FONT_5X8:
			dp = font5x8[No];
			Display_Graphic_5x8(page, column, dp);
			break;
		case FONT_8X16:
			dp = font8x16[No];
			Display_Graphic_8x16(page, column, dp);
			break;
		case FONT_16X16:
			dp = font16x16[No];
			Display_Graphic_16x16(page, column, dp);
			break;
		case FONT_128X64:
			dp = IMG128x64;
			Display_128x64(dp);
			break;
		case SCRIBING:
			Scribing();
			break;
		default:
			break;
	}		   
}


/*全屏清屏*/
void ClearScreen(void)
{
	unsigned char i,j;
	for(i=0;i<9;i++)
	{
		Write_ST7567_COM(0xb0+i);  //从第0页开始
		Write_ST7567_COM(0x10);
		Write_ST7567_COM(0x00);
		for(j=0;j<132;j++)
		{
		 	Write_ST7567_DISPLAY_DATA_serial(0x00);
		}
	}
}

void Display_PS(void)
{
	
	uint8_t i,j;
	uint8_t adressd=0;
	for(i=0;i<8;i++)
	{
		LCM_CSB(Bit_RESET);
		Write_ST7567_COM(0xb0+i);
	  Write_ST7567_COM(0x10);
		Write_ST7567_COM(0x00);
		for(j=0;j<128;j++)
		{
			Write_ST7567_DISPLAY_DATA_serial(graphicPS[adressd]);
			adressd++;
		}
	}
} 
